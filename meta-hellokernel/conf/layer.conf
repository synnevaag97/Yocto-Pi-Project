## meta-hellokernel/conf/layer.conf
```bitbake
# We have a conf and classes directory, add to BBPATH
BBPATH .= ":${LAYERDIR}"

# We have recipes-* directories, add to BBFILES
BBFILES += "${LAYERDIR}/recipes-*/*/*.bb \
            ${LAYERDIR}/recipes-*/*/*.bbappend"

BBFILE_COLLECTIONS += "meta-hellokernel"
BBFILE_PATTERN_meta-hellokernel = "^${LAYERDIR}/"
BBFILE_PRIORITY_meta-hellokernel = "6"

LAYERDEPENDS_meta-hellokernel = "core"
LAYERSERIES_COMPAT_meta-hellokernel = "kirkstone"
```

## meta-trym/conf/layer.conf
```bitbake
# We have a conf and classes directory, add to BBPATH
BBPATH .= ":${LAYERDIR}"

# We have recipes-* directories, add to BBFILES
BBFILES += "${LAYERDIR}/recipes-*/*/*.bb \
            ${LAYERDIR}/recipes-*/*/*.bbappend"

BBFILE_COLLECTIONS += "trymlayer"
BBFILE_PATTERN_trymlayer = "^${LAYERDIR}/"
BBFILE_PRIORITY_trymlayer = "5"
LAYERVERSION_trymlayer = "4"
LAYERSERIES_COMPAT_trymlayer = "kirkstone"
```
